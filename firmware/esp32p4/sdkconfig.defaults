## firmware/esp32p4/sdkconfig.defaults
```kconfig
CONFIG_IDF_TARGET="esp32p4"
# CONFIG_ESP32P4_SELECTS_REV_LESS_V3 is not set
# CONFIG_ESP32P4_REV_MIN_1 is not set
CONFIG_ESP32P4_REV_MIN_300=y
CONFIG_ESPTOOLPY_FLASHSIZE_16MB=y
CONFIG_ESP_MAIN_TASK_STACK_SIZE=65536
CONFIG_ESP_CONSOLE_UART_DEFAULT=y
CONFIG_ESP_CONSOLE_UART_BAUDRATE=115200
CONFIG_ESP_TASK_WDT_EN=n
CONFIG_COMPILER_OPTIMIZATION_PERF=y
CONFIG_FREERTOS_HZ=1000
```
